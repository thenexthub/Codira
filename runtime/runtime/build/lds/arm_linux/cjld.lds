/* Script for -pie -z combreloc: position independent executable, combine & sort relocs */

OUTPUT_FORMAT("elf32-littlearm", "elf32-bigarm",
	            "elf32-littlearm")
OUTPUT_ARCH(arm)
ENTRY(_start)
SEARCH_DIR("=/usr/local/lib/arm-linux-gnueabihf"); SEARCH_DIR("=/lib/arm-linux-gnueabihf"); SEARCH_DIR("=/usr/lib/arm-linux-gnueabihf"); SEARCH_DIR("=/usr/local/lib"); SEARCH_DIR("=/lib"); SEARCH_DIR("=/usr/lib"); SEARCH_DIR("=/usr/arm-linux-gnueabihf/lib");SEARCH_DIR("=/usr/lib32");SEARCH_DIR("=/usr/local/lib32"); SEARCH_DIR("=/lib32");
SECTIONS
{
  /* Read-only sections, merged into text segment: */
  PROVIDE (__executable_start = SEGMENT_START("text-segment", 0)); . = SEGMENT_START("text-segment", 0) + SIZEOF_HEADERS;
  .interp         : { *(.interp) }
  .note.gnu.build-id : { *(.note.gnu.build-id) }
  .hash           : { *(.hash) }
  .gnu.hash       : { *(.gnu.hash) }
  .dynsym         : { *(.dynsym) }
  .dynstr         : { *(.dynstr) }
  .gnu.version    : { *(.gnu.version) }
  .gnu.version_d  : { *(.gnu.version_d) }
  .gnu.version_r  : { *(.gnu.version_r) }
  .rela.dyn       :
    {
      *(.rela.init)
      *(.rela.text .rela.text.* .rela.gnu.linkonce.t.*)
      *(.rela.fini)
      *(.rela.rodata .rela.rodata.* .rela.gnu.linkonce.r.*)
      *(.rela.data .rela.data.* .rela.gnu.linkonce.d.*)
      *(.rela.tdata .rela.tdata.* .rela.gnu.linkonce.td.*)
      *(.rela.tbss .rela.tbss.* .rela.gnu.linkonce.tb.*)
      *(.rela.ctors)
      *(.rela.dtors)
      *(.rela.got)
      *(.rela.bss .rela.bss.* .rela.gnu.linkonce.b.*)
      *(.rela.ifunc)
    }
  .rela.plt       :
    {
      *(.rela.plt)
      PROVIDE_HIDDEN (__rela_iplt_start = .);
      *(.rela.iplt)
      PROVIDE_HIDDEN (__rela_iplt_end = .);
    }
  .init           :
  {
    KEEP (*(SORT_NONE(.init)))
  } =0
  .plt            : ALIGN(16) { *(.plt) *(.iplt) }
  .text           :
  {
    *(.text.unlikely .text.*_unlikely .text.unlikely.*)
    *(.text.exit .text.exit.*)
    *(.text.startup .text.startup.*)
    *(.text.hot .text.hot.*)
    *(.text .stub .gnu.linkonce.t.*)
    g_runtimeStaticStart = .;
    *(.text_runtime)
    *(SORT(.text.*MRT*))
    *(SORT(.text.*MCC*))
    *(SORT(.text.*MapleRuntime*))
    *(SORT(.text.*Monitor*))
    *(.text_thread)
    g_runtimeStaticEnd = .;
    *(SORT(.text.*))
    /* .codeinit_function sections follows the text section. */
    *(.codeinit_function .codeinit_function.*)
    /* .gnu.warning sections are handled specially by elf32.em.  */
    *(.gnu.warning)
  } =0
  .fini           :
  {
    KEEP (*(SORT_NONE(.fini)))
  } =0
  PROVIDE (__etext = .);
  PROVIDE (_etext = .);
  PROVIDE (etext = .);
  . = . + 0x1000; /* move to a new page in memory, necessary for arm32 */
  .rodata         : { *(.rodata .rodata.* .gnu.linkonce.r.*) }
  .rodata1        : { *(.rodata1) }
  . = . + 0x1000; /* move to a new page in memory */
  .eh_frame_hdr : { *(.eh_frame_hdr) *(.eh_frame_entry .eh_frame_entry.*) }
  .eh_frame       : ONLY_IF_RO { KEEP (*(.eh_frame)) *(.eh_frame.*) }
  .gcc_except_table   : ONLY_IF_RO { *(.gcc_except_table
  .gcc_except_table.*) }
  .gnu_extab   : ONLY_IF_RO { *(.gnu_extab*) }
  /* These sections are generated by the Sun/Oracle C++ compiler.  */
  .exception_ranges   : ONLY_IF_RO { *(.exception_ranges
  .exception_ranges*) }
  /* Adjust the address for the data segment.  We want to adjust up to
     the same address within the page on the next page up.  */
  . = DATA_SEGMENT_ALIGN (CONSTANT (MAXPAGESIZE), CONSTANT (COMMONPAGESIZE));
  /* Exception handling  */
  .eh_frame       : ONLY_IF_RW { KEEP (*(.eh_frame)) *(.eh_frame.*) }
  .gnu_extab      : ONLY_IF_RW { *(.gnu_extab) }
  .gcc_except_table   : ONLY_IF_RW { *(.gcc_except_table .gcc_except_table.*) }
  .exception_ranges   : ONLY_IF_RW { *(.exception_ranges .exception_ranges*) }
  /* Thread Local Storage sections  */
  .tdata          : { *(.maplert_tls) *(.tdata .tdata.* .gnu.linkonce.td.*) }
  .tbss           : { *(.tbss .tbss.* .gnu.linkonce.tb.*) *(.tcommon) }
  .preinit_array     :
  {
    PROVIDE_HIDDEN (__preinit_array_start = .);
    KEEP (*(.preinit_array))
    PROVIDE_HIDDEN (__preinit_array_end = .);
  }
  .init_array     :
  {
    PROVIDE_HIDDEN (__init_array_start = .);
    KEEP (*(SORT_BY_INIT_PRIORITY(.init_array.*) SORT_BY_INIT_PRIORITY(.ctors.*)))
    KEEP (*(.init_array EXCLUDE_FILE (*crtbegin.o *crtbegin?.o *crtend.o *crtend?.o ) .ctors))
    PROVIDE_HIDDEN (__init_array_end = .);
  }
  .fini_array     :
  {
    PROVIDE_HIDDEN (__fini_array_start = .);
    KEEP (*(SORT_BY_INIT_PRIORITY(.fini_array.*) SORT_BY_INIT_PRIORITY(.dtors.*)))
    KEEP (*(.fini_array EXCLUDE_FILE (*crtbegin.o *crtbegin?.o *crtend.o *crtend?.o ) .dtors))
    PROVIDE_HIDDEN (__fini_array_end = .);
  }
  .ctors          :
  {
    /* gcc uses crtbegin.o to find the start of
       the constructors, so we make sure it is
       first.  Because this is a wildcard, it
       doesn't matter if the user does not
       actually link against crtbegin.o; the
       linker won't look for a file to match a
       wildcard.  The wildcard also means that it
       doesn't matter which directory crtbegin.o
       is in.  */
    KEEP (*crtbegin.o(.ctors))
    KEEP (*crtbegin?.o(.ctors))
    /* We don't want to include the .ctor section from
       the crtend.o file until after the sorted ctors.
       The .ctor section from the crtend file contains the
       end of ctors marker and it must be last */
    KEEP (*(EXCLUDE_FILE (*crtend.o *crtend?.o ) .ctors))
    KEEP (*(SORT(.ctors.*)))
    KEEP (*(.ctors))
  }
  .dtors          :
  {
    KEEP (*crtbegin.o(.dtors))
    KEEP (*crtbegin?.o(.dtors))
    KEEP (*(EXCLUDE_FILE (*crtend.o *crtend?.o ) .dtors))
    KEEP (*(SORT(.dtors.*)))
    KEEP (*(.dtors))
  }
  .jcr            : { KEEP (*(.jcr)) }
  .data.rel.ro : { *(.data.rel.ro.local* .gnu.linkonce.d.rel.ro.local.*) *(.data.rel.ro .data.rel.ro.* .gnu.linkonce.d.rel.ro.*) }
  .dynamic        : { *(.dynamic) }
  .got            : { *(.got) *(.igot) }
  . = DATA_SEGMENT_RELRO_END (24, .);
  .got.plt        : { *(.got.plt)  *(.igot.plt) }
  . = . + 0x1000; /* move to a new page in memory */
  .data           :
  {
    PROVIDE (__data_start = .);
    *(.data .data.* .gnu.linkonce.d.*)
    SORT(CONSTRUCTORS)
  }
  .data1          : { *(.data1) }
  /* Codira Metadata sections start */
  . = ALIGN(16);
  _CODEMetadataStart = .;
  PROVIDE_HIDDEN(__CODEMetadataStart = .);
  .codemetadata : {
      KEEP(*codestart.o(.codemetadata.rw.header))

       . = ALIGN(16);
      PROVIDE_HIDDEN(__CODESDKVersion = . - __CODEMetadataStart);
      KEEP(*(.codemetadata.sdk.version))
      KEEP(*(SORT(.codemetadata.sdk.version.*)))
      PROVIDE_HIDDEN(__CODESDKVersionEnd = . - __CODEMetadataStart);

      . = ALIGN(16);
      PROVIDE_HIDDEN(__CODEMethodInfo = . - __CODEMetadataStart);
      KEEP(*(.codemetadata.methodinfo))
      KEEP(*(SORT(.codemetadata.methodinfo.*)))
      PROVIDE_HIDDEN(__CODEMethodInfoEnd = . - __CODEMetadataStart);

      . = ALIGN(16);
      PROVIDE_HIDDEN(__CODEGlobalInitFunc = . - __CODEMetadataStart);
      KEEP(*(.codemetadata.globalInitFunc))
      KEEP(*(SORT(.codemetadata.globalInitFunc.*)))
      PROVIDE_HIDDEN(__CODEGlobalInitFuncEnd = . - __CODEMetadataStart);

      . = ALIGN(16);
      PROVIDE_HIDDEN(__CODEStringPoolDict = . - __CODEMetadataStart);
      KEEP(*(.codemetadata.stringpooldict))
      KEEP(*(SORT(.codemetadata.stringpooldict.*)))
      PROVIDE_HIDDEN(__CODEStringPoolDictEnd = . - __CODEMetadataStart);

      . = ALIGN(16);
      PROVIDE_HIDDEN(__CODEStringPool = . - __CODEMetadataStart);
      KEEP(*(.codemetadata.stringpool))
      KEEP(*(SORT(.codemetadata.stringpool.*)))
      PROVIDE_HIDDEN(__CODEStringPoolEnd = . - __CODEMetadataStart);

      . = ALIGN(16);
      PROVIDE_HIDDEN(__CODEStackMap = . - __CODEMetadataStart);
      KEEP(*(.codemetadata.stackmap))
      KEEP(*(SORT(.codemetadata.stackmap.*)))
      PROVIDE_HIDDEN(__CODEStackMapEnd = . - __CODEMetadataStart);

      . = ALIGN(16);
      PROVIDE_HIDDEN(__CODEGCTib = . - __CODEMetadataStart);
      KEEP(*(.codemetadata.gctib))
      KEEP(*(SORT(.codemetadata.gctib.*)))
      PROVIDE_HIDDEN(__CODEGCTibEnd = . - __CODEMetadataStart);

      . = ALIGN(16);
      PROVIDE_HIDDEN(__CODEGCRoots = . - __CODEMetadataStart);
      KEEP(*(.codemetadata.gcroots))
      KEEP(*(SORT(.codemetadata.gcroots.*)))
      PROVIDE_HIDDEN(__CODEGCRootsEnd = . - __CODEMetadataStart);

      . = ALIGN(16);
      PROVIDE_HIDDEN(__CODETypeTemplate = . - __CODEMetadataStart);
      KEEP(*(.codemetadata.typetemplate))
      KEEP(*(SORT(.codemetadata.typetemplate.*)))
      PROVIDE_HIDDEN(__CODETypeTemplateEnd = . - __CODEMetadataStart);

      . = ALIGN(16);
      PROVIDE_HIDDEN(__CODETypeInfo = . - __CODEMetadataStart);
      KEEP(*(.codemetadata.typeinfo))
      KEEP(*(SORT(.codemetadata.typeinfo.*)))
      PROVIDE_HIDDEN(__CODETypeInfoEnd = . - __CODEMetadataStart);

      . = ALIGN(16);
      PROVIDE_HIDDEN(__CODETypeFields = . - __CODEMetadataStart);
      KEEP(*(.codemetadata.type.fields))
      KEEP(*(SORT(.codemetadata.type.fields.*)))
      PROVIDE_HIDDEN(__CODETypeFieldsEnd = . - __CODEMetadataStart);

      . = ALIGN(16);
      PROVIDE_HIDDEN(__CODEMTable = . - __CODEMetadataStart);
      KEEP(*(.codemetadata.mtable))
      KEEP(*(SORT(.codemetadata.mtable.*)))
      PROVIDE_HIDDEN(__CODEMTableEnd = . - __CODEMetadataStart);

      . = ALIGN(16);
      PROVIDE_HIDDEN(__CODEInnerTypeExtensions = . - __CODEMetadataStart);
      KEEP(*(.codemetadata.innerty.eds))
      KEEP(*(SORT(.codemetadata.innerty.eds.*)))
      PROVIDE_HIDDEN(__CODEInnerTypeExtensionsEnd = . - __CODEMetadataStart);

      . = ALIGN(16);
      PROVIDE_HIDDEN(__CODEOuterTypeExtensions = . - __CODEMetadataStart);
      KEEP(*(.codemetadata.outerty.eds))
      KEEP(*(SORT(.codemetadata.outerty.eds.*)))
      PROVIDE_HIDDEN(__CODEOuterTypeExtensionsEnd = . - __CODEMetadataStart);

      . = ALIGN(16);
      PROVIDE_HIDDEN(__CODEStaticGITable = . - __CODEMetadataStart);
      KEEP(*(.codemetadata.static.generic.ti))
      KEEP(*(SORT(.codemetadata.static.generic.ti.*)))
      PROVIDE_HIDDEN(__CODEStaticGITableEnd = . - __CODEMetadataStart);

      . = ALIGN(16);
      PROVIDE_HIDDEN(__CODEGCFlags = . - __CODEMetadataStart);
      KEEP(*(.codemetadata.gcflags))
      PROVIDE_HIDDEN(__CODEGCFlagsEnd = . - __CODEMetadataStart);

      . = ALIGN(16);
      PROVIDE_HIDDEN(__CODEReflectPkgInfo = . - __CODEMetadataStart);
      KEEP(*(.codemetadata.reflect.pkginfo))
      KEEP(*(SORT(.codemetadata.reflect.pkginfo.*)))
      PROVIDE_HIDDEN(__CODEReflectPkgInfoEnd = . - __CODEMetadataStart);

      . = ALIGN(16);
      PROVIDE_HIDDEN(__CODEReflectGV = . - __CODEMetadataStart);
      KEEP(*(.codemetadata.reflect.gv))
      KEEP(*(SORT(.codemetadata.reflect.gv.*)))
      PROVIDE_HIDDEN(__CODEReflectGVEnd = . - __CODEMetadataStart);

      . = ALIGN(16);
      PROVIDE_HIDDEN(__CODEReflectGI = . - __CODEMetadataStart);
      KEEP(*(.codemetadata.reflect.generic.ti))
      KEEP(*(SORT(.codemetadata.reflect.generic.ti.*)))
      PROVIDE_HIDDEN(__CODEReflectGIEnd = . - __CODEMetadataStart);

      . = ALIGN(16);
      PROVIDE_HIDDEN(__CODETypeExt = . - __CODEMetadataStart);
      KEEP(*(.codemetadata.type.ext))
      KEEP(*(SORT(.codemetadata.type.ext.*)))
      PROVIDE_HIDDEN(__CODETypeExtEnd = . - __CODEMetadataStart);
  }
  PROVIDE_HIDDEN(__CODEMethodInfoSize = __CODEMethodInfoEnd - __CODEMethodInfo);
  PROVIDE_HIDDEN(__CODEGlobalInitFuncSize = __CODEGlobalInitFuncEnd - __CODEGlobalInitFunc);
  PROVIDE_HIDDEN(__CODEStringPoolDictSize = __CODEStringPoolDictEnd - __CODEStringPoolDict);
  PROVIDE_HIDDEN(__CODEStringPoolSize = __CODEStringPoolEnd - __CODEStringPool);
  PROVIDE_HIDDEN(__CODEStackMapSize   = __CODEStackMapEnd - __CODEStackMap);
  PROVIDE_HIDDEN(__CODEGCTibSize      = __CODEGCTibEnd - __CODEGCTib);
  PROVIDE_HIDDEN(__CODEGCRootsSize    = __CODEGCRootsEnd - __CODEGCRoots);
  PROVIDE_HIDDEN(__CODETypeTemplateSize  = __CODETypeTemplateEnd - __CODETypeTemplate);
  PROVIDE_HIDDEN(__CODETypeInfoSize  = __CODETypeInfoEnd - __CODETypeInfo);
  PROVIDE_HIDDEN(__CODETypeFieldsSize  = __CODETypeFieldsEnd - __CODETypeFields);
  PROVIDE_HIDDEN(__CODETypeExtSize  = __CODETypeExtEnd - __CODETypeExt);
  PROVIDE_HIDDEN(__CODEMTableSize     = __CODEMTableEnd - __CODEMTable);
  PROVIDE_HIDDEN(__CODEInnerTypeExtensionsSize = __CODEInnerTypeExtensionsEnd - __CODEInnerTypeExtensions);
  PROVIDE_HIDDEN(__CODEOuterTypeExtensionsSize = __CODEOuterTypeExtensionsEnd - __CODEOuterTypeExtensions);
  PROVIDE_HIDDEN(__CODEStaticGITableSize = __CODEStaticGITableEnd - __CODEStaticGITable);
  PROVIDE_HIDDEN(__CODEGCFlagsSize = __CODEGCFlagsEnd - __CODEGCFlags);
  PROVIDE_HIDDEN(__CODEGCReflectPkgInfoSize = __CODEReflectPkgInfoEnd - __CODEReflectPkgInfo);
  PROVIDE_HIDDEN(__CODEReflectGVSize = __CODEReflectGVEnd - __CODEReflectGV);
  PROVIDE_HIDDEN(__CODEReflectGISize = __CODEReflectGIEnd - __CODEReflectGI);
  PROVIDE_HIDDEN(__CODEMetaDataSize = . - __CODEMetadataStart);
  /* Codira Metadata sections end */
  _edata = .; PROVIDE (edata = .);
  . = .;
  __bss_start = .;
  __bss_start__ = .;
  .bss            :
  {
   *(.dynbss)
   *(.bss .bss.* .gnu.linkonce.b.*)
   *(COMMON)
   /* Align here to ensure that the .bss section occupies space up to
      _end.  Align after .bss to ensure correct alignment even if the
      .bss section disappears because there are no input sections. */
   . = ALIGN(. != 0 ? 64 / 8 : 1);
  }
  _bss_end__ = . ; __bss_end__ = . ;
  . = ALIGN(64 / 8);
  . = SEGMENT_START("ldata-segment", .);
  . = ALIGN(64 / 8);
  __end__ = . ;
  _end = .; PROVIDE (end = .);
  . = DATA_SEGMENT_END (.);
  /* Stabs debugging sections.  */
  .stab          0 : { *(.stab) }
  .stabstr       0 : { *(.stabstr) }
  .stab.excl     0 : { *(.stab.excl) }
  .stab.exclstr  0 : { *(.stab.exclstr) }
  .stab.index    0 : { *(.stab.index) }
  .stab.indexstr 0 : { *(.stab.indexstr) }
  .comment       0 : { *(.comment) }
  /* DWARF debug sections.
     Symbols in the DWARF debugging sections are relative to the beginning
     of the section so we begin them at 0.  */
  /* DWARF 1 */
  .debug          0 : { *(.debug) }
  .line           0 : { *(.line) }
  /* GNU DWARF 1 extensions */
  .debug_srcinfo  0 : { *(.debug_srcinfo) }
  .debug_sfnames  0 : { *(.debug_sfnames) }
  /* DWARF 1.1 and DWARF 2 */
  .debug_aranges  0 : { *(.debug_aranges) }
  .debug_pubnames 0 : { *(.debug_pubnames) }
  /* DWARF 2 */
  .debug_info     0 : { *(.debug_info .gnu.linkonce.wi.*) }
  .debug_abbrev   0 : { *(.debug_abbrev) }
  .debug_line     0 : { *(.debug_line .debug_line.* .debug_line_end ) }
  .debug_frame    0 : { *(.debug_frame) }
  .debug_str      0 : { *(.debug_str) }
  .debug_loc      0 : { *(.debug_loc) }
  .debug_macinfo  0 : { *(.debug_macinfo) }
  /* SGI/MIPS DWARF 2 extensions */
  .debug_weaknames 0 : { *(.debug_weaknames) }
  .debug_funcnames 0 : { *(.debug_funcnames) }
  .debug_typenames 0 : { *(.debug_typenames) }
  .debug_varnames  0 : { *(.debug_varnames) }
  /* DWARF 3 */
  .debug_pubtypes 0 : { *(.debug_pubtypes) }
  .debug_ranges   0 : { *(.debug_ranges) }
  /* DWARF Extension.  */
  .debug_macro    0 : { *(.debug_macro) }
  .debug_addr     0 : { *(.debug_addr) }
  .ARM.attributes 0 : { KEEP (*(.ARM.attributes)) KEEP (*(.gnu.attributes)) }
  .note.gnu.arm.ident 0 : { KEEP (*(.note.gnu.arm.ident)) }
  /DISCARD/ : { *(.note.GNU-stack) *(.gnu_debuglink) *(.gnu.lto_*) }
}
